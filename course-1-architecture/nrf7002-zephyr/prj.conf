## CMakeLists.txt
```
cmake_minimum_required(VERSION 3.20.0)
find_package(Zephyr REQUIRED HINTS $ENV{ZEPHYR_BASE})

project(nrf7002-zephyr)

target_sources(app PRIVATE src/main.c)
```

## prj.conf
```kconfig
CONFIG_GPIO=y # Enables GPIO drivers.
```

## app.overlay
```dts
/ {
    aliases {
        /* We are creating a custom name for our C code to use */
        my-custom-led = &external_led;
    };

    leds {
        compatible = "gpio-leds";
        external_led: led_external {
            /* P1.02 = Arduino header D14
             * Not claimed by GPIO forwarder, LEDs, or buttons.
             * (P1.05 was taken by nrf-gpio-forwarder for net core UART) */
            gpios = <&gpio1 2 GPIO_ACTIVE_HIGH>;
            label = "External Green LED";
        };
    };
};
```

## src/main.c
```c
#include <zephyr/kernel.h>
#include <zephyr/drivers/gpio.h>

/* 1. We renamed the macro to match our custom hardware */
#define MY_LED_NODE DT_ALIAS(my_custom_led)

/* 2. We renamed the variable to my_led */
static const struct gpio_dt_spec my_led = GPIO_DT_SPEC_GET(MY_LED_NODE, gpios);

int main(void)
{
    /* 3. Pass the new my_led variable to the Zephyr functions */
    if (!gpio_is_ready_dt(&my_led)) {
        return 0;
    }

    if (gpio_pin_configure_dt(&my_led, GPIO_OUTPUT_ACTIVE) < 0) {
        return 0;
    }

    while (1) {
        gpio_pin_toggle_dt(&my_led);
        k_msleep(100); 
        gpio_pin_toggle_dt(&my_led);
        k_msleep(2000); 
    }
    return 0;
}
```
